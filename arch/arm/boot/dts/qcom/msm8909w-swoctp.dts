/*
 * Copyright (c) 2016, The Linux Foundation. All rights reserved.
 *
 * This program is free software; you can redistribute it and/or modify
 * it under the terms of the GNU General Public License version 2 and
 * only version 2 as published by the Free Software Foundation.
 *
 * This program is distributed in the hope that it will be useful,
 * but WITHOUT ANY WARRANTY; without even the implied warranty of
 * MERCHANTABILITY or FITNESS FOR A PARTICULAR PURPOSE.  See the
 * GNU General Public License for more details.
 */

/dts-v1/;

#include "msm8909w-swoctp.dtsi"

/ {
<<<<<<<< HEAD:arch/arm/boot/dts/qcom/msm8909w-swoctp.dts
	model = "Qualcomm Technologies, Inc. MSM8909W-PM8916 SWOC MTP";
========
	model = "Qualcomm Technologies, Inc. MSM8909W-PM8916 1GB SWOC TP";
>>>>>>>> 4dc57c12e7e598c824a00f25f1cfe1b5226221ed:arch/arm/boot/dts/qcom/msm8909w-1gb-swoctp.dts
	compatible = "qcom,msm8909-mtp", "qcom,msm8909", "qcom,mtp";
	qcom,msm-id =   <245 0>,
			<258 0>,
			<275 0>,
			<300 0>;
<<<<<<<< HEAD:arch/arm/boot/dts/qcom/msm8909w-swoctp.dts
	qcom,board-id= <8 0x109>;
========
	qcom,board-id= <8 0x9>; /* CX, APC split with PM8916+SMB231, STC3117 */
>>>>>>>> 4dc57c12e7e598c824a00f25f1cfe1b5226221ed:arch/arm/boot/dts/qcom/msm8909w-1gb-swoctp.dts
};
